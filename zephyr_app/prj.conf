## CMakeLists.txt
```
# MCU Diagnostic Test Firmware - Zephyr Application
# This firmware runs on the target MCU and performs peripheral self-tests

cmake_minimum_required(VERSION 3.20.0)
find_package(Zephyr REQUIRED HINTS $ENV{ZEPHYR_BASE})
project(mcu_diagnostic_firmware)

# Parse test suites from CMake command line
if(NOT DEFINED DIAGNOSTIC_TEST_SUITES)
    set(DIAGNOSTIC_TEST_SUITES "basic;gpio;adc;dac;uart;spi;i2c;timing;memory;clock")
endif()

# Convert the CMake list into one comma-separated C string.
string(REPLACE ";" "," TEST_SUITES_STR "${DIAGNOSTIC_TEST_SUITES}")
add_compile_definitions(DIAGNOSTIC_TEST_SUITES=\"${TEST_SUITES_STR}\")

# Enable required features
target_sources(app PRIVATE
    src/main.c
    src/tests/test_framework.c
    src/tests/basic_tests.c
    src/tests/gpio_tests.c
    src/tests/adc_tests.c
    src/tests/dac_tests.c
    src/tests/uart_tests.c
    src/tests/spi_tests.c
    src/tests/i2c_tests.c
    src/tests/timer_tests.c
    src/tests/memory_tests.c
    src/tests/clock_tests.c
    src/comm/reporting.c
    src/comm/serial_protocol.c
)

# Include directories
target_include_directories(app PRIVATE
    ${CMAKE_CURRENT_SOURCE_DIR}/src
    ${CMAKE_CURRENT_SOURCE_DIR}/src/tests
    ${CMAKE_CURRENT_SOURCE_DIR}/src/comm
)

# Compile definitions
target_compile_definitions(app PRIVATE
    DIAGNOSTIC_FIRMWARE_VERSION=1
    CONFIG_DIAGNOSTIC_BUFFER_SIZE=2048
)


# Zephyr's CMake package links enabled kernel/drivers through app; do not
# manually link synthetic driver target names.
```

## west.yml
```
manifest:
  version: "1.2"
  remotes:
    - name: zephyrproject
      url-base: https://github.com/zephyrproject-rtos
  projects:
    - name: zephyr
      remote: zephyrproject
      revision: v4.4.2
      import: true
  self:
    # This application lives in a subdirectory of the main repository.
    path: .
```

## prj.conf
```kconfig
# MCU Diagnostic Firmware - Zephyr Configuration

# Kernel
CONFIG_MULTITHREADING=y
CONFIG_INIT_STACKS=y
CONFIG_THREAD_STACK_INFO=y

# Logging
CONFIG_LOG=y
CONFIG_LOG_MODE_IMMEDIATE=y
CONFIG_LOG_BACKEND_UART=y
CONFIG_LOG_BACKEND_SHOW_COLOR=y
CONFIG_LOG_RUNTIME_FILTERING=y

# Shell
CONFIG_SHELL=y
CONFIG_SHELL_BACKEND_SERIAL=y
CONFIG_SHELL_CMDS_RESIZE=y
CONFIG_SHELL_HISTORY=y

# Console
CONFIG_CONSOLE=y
CONFIG_UART_CONSOLE=y

# GPIO
CONFIG_GPIO=y

# ADC
CONFIG_ADC=y

# DAC
CONFIG_DAC=y

# UART
CONFIG_SERIAL=y
CONFIG_UART_INTERRUPT_DRIVEN=y
CONFIG_UART_LINE_CTRL=y
CONFIG_UART_DRV_CMD=y

# SPI
CONFIG_SPI=y

# I2C
CONFIG_I2C=y

# PWM
CONFIG_PWM=y
CONFIG_PWM_CAPTURE=y

# Counter/Timer
CONFIG_COUNTER=y

# Flash
CONFIG_FLASH=y
CONFIG_FLASH_MAP=y

# Entropy/RNG (selected board drivers provide the hardware backend)
CONFIG_ENTROPY_GENERATOR=y

# Hardware Info
CONFIG_HWINFO=y

# Settings/Storage

# CRC

# Newlib supports the floating-point formatting used by measurement reports

# Optimization

# Debug
CONFIG_DEBUG=y
CONFIG_ASSERT=y
CONFIG_ASSERT_LEVEL=2

# Memory protection (if supported)
```

## boards/arduino_mega.conf
```kconfig
/**
 * Zephyr board configuration for Arduino Mega (ATmega2560)
 */

#include <zephyr/kernel.h>

/* GPIO configuration */
#define GPIO_PORTS "gpioa", "gpiob", "gpioc", "gpiod", "gpioe", "gpiof", "gpiog", "gpioh", "gpioj", "gpiok", "gpiol"

/* ADC configuration */
#define ADC_CHANNELS 16

/* UART configuration - console on UART0 (PE0/PE1) */
#define CONSOLE_UART "uart0"

/* SPI configuration - SPI0 */
#define SPI_BUS "spi0"

/* I2C configuration - I2C0 */
#define I2C_BUS "i2c0"

/* PWM configuration */
#define PWM_DEV "pwm0"

/* Counter/TIMER */
#define TIMER_DEV "timer0"

/* Flash */
#define FLASH_DEV "flash0"

/* Entropy/RNG */
#define ENTROPY_DEV "rng"
```

## boards/arduino_mkr_zero.conf
```kconfig
/**
 * Zephyr board configuration for Arduino MKR Zero (ATSAMD21E18)
 */

#include <zephyr/kernel.h>

/* GPIO configuration */
#define GPIO_PORTS "gpioa", "gpiob"

/* ADC configuration */
#define ADC_CHANNELS 14

/* UART configuration - console on SERCOM0 */
#define CONSOLE_UART "uart0"

/* SPI configuration */
#define SPI_BUS "spi0"

/* I2C configuration */
#define I2C_BUS "i2c0"

/* PWM configuration */
#define PWM_DEV "pwm0"

/* Counter/TIMER */
#define TIMER_DEV "timer0"

/* Flash */
#define FLASH_DEV "flash0"

/* Entropy/RNG */
#define ENTROPY_DEV "rng"

/* USB */
#define USB_DEV "usb_dc"
```

## boards/arduino_nano_33_iot.conf
```kconfig
/**
 * Zephyr board configuration for Arduino Nano 33 IoT (ATSAMD51J19)
 */

#include <zephyr/kernel.h>

/* GPIO configuration */
#define GPIO_PORTS "gpioa", "gpiob", "gpioc", "gpiod"

/* ADC configuration */
#define ADC_CHANNELS 16

/* UART configuration - console on SERCOM0 */
#define CONSOLE_UART "uart0"

/* SPI configuration */
#define SPI_BUS "spi0"

/* I2C configuration */
#define I2C_BUS "i2c0"

/* PWM configuration */
#define PWM_DEV "pwm0"

/* Counter/TIMER */
#define TIMER_DEV "timer0"

/* Flash */
#define FLASH_DEV "flash0"

/* Entropy/RNG */
#define ENTROPY_DEV "rng"

/* USB */
#define USB_DEV "usb_dc"

/* WiFi */
#define WIFI_DEV "wifi0"
```

## boards/arduino_uno.conf
```kconfig
/**
 * Zephyr board configuration for Arduino Uno (ATmega328P)
 */

#include <zephyr/kernel.h>

/* GPIO configuration */
#define GPIO_PORTS "gpiob", "gpioc", "gpiod"

/* ADC configuration */
#define ADC_CHANNELS 6

/* UART configuration - console on UART0 (PD0/PD1) */
#define CONSOLE_UART "uart0"

/* SPI configuration - SPI0 */
#define SPI_BUS "spi0"

/* I2C configuration - I2C0 */
#define I2C_BUS "i2c0"

/* PWM configuration - TIMER0, TIMER1, TIMER2 */
#define PWM_DEV "pwm0"

/* Counter/TIMER */
#define TIMER_DEV "timer0"

/* Flash */
#define FLASH_DEV "flash0"

/* Entropy/RNG */
#define ENTROPY_DEV "rng"
```

## boards/arduino_zero.conf
```kconfig
/**
 * Zephyr board configuration for Arduino Zero (ATSAMD21G18)
 */

#include <zephyr/kernel.h>

/* GPIO configuration */
#define GPIO_PORTS "gpioa", "gpiob"

/* ADC configuration */
#define ADC_CHANNELS 14

/* UART configuration - console on SERCOM0 (PA11/PA10) */
#define CONSOLE_UART "uart0"

/* SPI configuration - SERCOM1, SERCOM2, SERCOM3, SERCOM4, SERCOM5 */
#define SPI_BUS "spi0"

/* I2C configuration - SERCOM0, SERCOM1, SERCOM2, SERCOM3, SERCOM4, SERCOM5 */
#define I2C_BUS "i2c0"

/* PWM configuration - TCC0, TCC1, TCC2, TC3, TC4, TC5 */
#define PWM_DEV "pwm0"

/* Counter/TIMER */
#define TIMER_DEV "timer0"

/* Flash */
#define FLASH_DEV "flash0"

/* Entropy/RNG */
#define ENTROPY_DEV "rng"

/* USB */
#define USB_DEV "usb_dc"
```

## boards/esp32_devkitc.conf
```kconfig
/**
 * Zephyr board configuration for ESP32 DevKitC
 */

#include <zephyr/kernel.h>

/* GPIO configuration */
#define GPIO_PORTS "gpio0", "gpio1"

/* ADC configuration */
#define ADC_CHANNELS 18

/* UART configuration - console on UART0 (GPIO1/GPIO3) */
#define CONSOLE_UART "uart0"

/* SPI configuration - SPI2, SPI3 */
#define SPI_BUS "spi2"

/* I2C configuration - I2C0 */
#define I2C_BUS "i2c0"

/* PWM configuration - LEDC */
#define PWM_DEV "ledc0"

/* Counter/TIMER */
#define TIMER_DEV "timer0"

/* Flash */
#define FLASH_DEV "flash0"

/* Entropy/RNG */
#define ENTROPY_DEV "rng"

/* WiFi */
#define WIFI_DEV "wifi0"

/* Bluetooth */
#define BT_DEV "bt0"
```

## src/main.c
```c
/**
 * MCU Diagnostic Firmware - Main Entry Point
 * Runs peripheral self-tests and reports results via serial/UART.
 */

#include <zephyr/kernel.h>
#include <zephyr/device.h>
#include <zephyr/drivers/gpio.h>
#include <zephyr/drivers/uart.h>
#include <zephyr/drivers/hwinfo.h>
#include <zephyr/logging/log.h>
#include <zephyr/shell/shell.h>
#include <string.h>
#include <stdio.h>

#include "test_framework.h"
#include "reporting.h"
#include "serial_protocol.h"

LOG_MODULE_REGISTER(diagnostic_main, LOG_LEVEL_INF);

#define TEST_UART_NODE DT_CHOSEN(zephyr_console)

static const struct device *uart_dev = DEVICE_DT_GET(TEST_UART_NODE);
static struct diagnostic_context diag_ctx;
static uint8_t report_buffer[CONFIG_DIAGNOSTIC_BUFFER_SIZE];

/* Each test module exports a sentinel-terminated array of test_case records. */
extern const struct test_case basic_tests[];
extern const struct test_case gpio_tests[];
extern const struct test_case adc_tests[];
extern const struct test_case dac_tests[];
extern const struct test_case uart_tests[];
extern const struct test_case spi_tests[];
extern const struct test_case i2c_tests[];
extern const struct test_case timer_tests[];
extern const struct test_case memory_tests[];
extern const struct test_case clock_tests[];

struct suite_entry {
    const char *name;
    const struct test_case *cases;
    bool required;
};

/* Suite names map to the actual arrays exported by the firmware modules. */
static const struct suite_entry test_suites[] = {
    {"basic", basic_tests, true},
    {"gpio", gpio_tests, false},
    {"adc", adc_tests, false},
    {"dac", dac_tests, false},
    {"uart", uart_tests, false},
    {"spi", spi_tests, false},
    {"i2c", i2c_tests, false},
    {"timing", timer_tests, false},
    {"memory", memory_tests, false},
    {"clock", clock_tests, false},
    {NULL, NULL, false}
};

static int count_test_cases(const struct test_case *cases)
{
    int count = 0;

    if (cases == NULL) {
        return 0;
    }
    while (cases[count].name != NULL) {
        count++;
    }
    return count;
}

int main(void)
{
    int ret;

    LOG_INF("MCU Diagnostic Firmware v%d starting...", DIAGNOSTIC_FIRMWARE_VERSION);

    ret = diagnostic_init(&diag_ctx, uart_dev, report_buffer, sizeof(report_buffer));
    if (ret < 0) {
        LOG_ERR("Failed to initialize diagnostics: %d", ret);
        return ret;
    }

    reporting_init(uart_dev);

    uint8_t dev_id[32] = {0};
    size_t id_len = 0;
    int id_bytes = (int)hwinfo_get_device_id(dev_id, sizeof(dev_id));
    if (id_bytes < 0) {
        LOG_WRN("MCU device ID unavailable: %d", id_bytes);
    } else if ((size_t)id_bytes > sizeof(dev_id)) {
        id_len = sizeof(dev_id);
    } else {
        id_len = (size_t)id_bytes;
    }
    diagnostic_set_device_id(&diag_ctx, dev_id, id_len);
    diagnostic_send_device_info(&diag_ctx);

    /* CMake expands this list into a string literal; copy it before strtok mutates it. */
    char enabled_suites[] = DIAGNOSTIC_TEST_SUITES;
    char *suite_name = strtok(enabled_suites, ",");

    LOG_INF("Starting diagnostic test suites...");
    while (suite_name != NULL) {
        const struct suite_entry *entry = NULL;
        for (size_t i = 0; test_suites[i].name != NULL; i++) {
            if (strcmp(test_suites[i].name, suite_name) == 0) {
                entry = &test_suites[i];
                break;
            }
        }

        if (entry != NULL) {
            struct test_suite suite = {
                .name = entry->name,
                .tests = entry->cases,
                .test_count = count_test_cases(entry->cases),
                .required = entry->required,
            };
            if (suite.test_count == 0) {
                LOG_WRN("Suite %s has no test cases", suite_name);
            } else {
                LOG_INF("Running suite: %s (%d tests)", suite.name, suite.test_count);
                ret = diagnostic_run_suite(&diag_ctx, &suite);
                if (ret < 0) {
                    LOG_ERR("Suite %s failed: %d", suite_name, ret);
                    if (entry->required) {
                        LOG_ERR("Required suite failed, aborting remaining tests");
                        break;
                    }
                }
            }
        } else {
            LOG_WRN("Unknown test suite: %s", suite_name);
        }

        suite_name = strtok(NULL, ",");
    }

    LOG_INF("All tests complete, sending final report");
    diagnostic_send_final_report(&diag_ctx);
    LOG_INF("Diagnostic tests completed. Type 'diag list' in the shell to inspect test names.");
    return 0;
}

/* Shell commands for interactive testing. */
static int cmd_run_test(const struct shell *shell, size_t argc, char **argv)
{
    if (argc < 2) {
        shell_print(shell, "Usage: diag run <test_name>");
        return -EINVAL;
    }

    struct test_result result;
    int ret = diagnostic_run_single_test(&diag_ctx, argv[1], &result);
    if (ret < 0) {
        shell_print(shell, "Test not found or could not run: %s", argv[1]);
        return ret;
    }

    const char *status = "UNKNOWN";
    if (result.status == TEST_PASS) {
        status = "PASS";
    } else if (result.status == TEST_FAIL) {
        status = "FAIL";
    } else if (result.status == TEST_SKIP) {
        status = "SKIP";
    } else if (result.status == TEST_ERROR) {
        status = "ERROR";
    }
    shell_print(shell, "Test: %s - %s", result.name, status);
    if (result.details[0] != '\0') {
        shell_print(shell, "Details: %s", result.details);
    }
    return 0;
}

static int cmd_list_tests(const struct shell *shell, size_t argc, char **argv)
{
    shell_print(shell, "Available tests:");
    for (size_t i = 0; test_suites[i].name != NULL; i++) {
        shell_print(shell, "  Suite: %s", test_suites[i].name);
        for (int j = 0; test_suites[i].cases[j].name != NULL; j++) {
            shell_print(shell, "    %s", test_suites[i].cases[j].name);
        }
    }
    return 0;
}

static int cmd_get_report(const struct shell *shell, size_t argc, char **argv)
{
    diagnostic_send_final_report(&diag_ctx);
    shell_print(shell, "Report sent via UART");
    return 0;
}

SHELL_STATIC_SUBCMD_SET_CREATE(diagnostic_cmds,
    SHELL_CMD(run, NULL, "Run a specific test by name", cmd_run_test),
    SHELL_CMD(list, NULL, "List available test suites and tests", cmd_list_tests),
    SHELL_CMD(report, NULL, "Send the final report over UART", cmd_get_report),
    SHELL_SUBCMD_SET_END
);

SHELL_CMD_REGISTER(diag, &diagnostic_cmds, "MCU diagnostic commands", NULL);
```
